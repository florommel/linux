## Kconfig
```kconfig
#
# For a description of the syntax of this configuration file,
# see Documentation/kbuild/kconfig-language.txt.
#
mainmenu "Linux/$ARCH $KERNELVERSION Kernel Configuration"

config SRCARCH
        string
        option env="SRCARCH"

source "arch/$SRCARCH/Kconfig"


config CONSTRUCTORS
 tristate "Enable constructors"
 select CONFIG_CONSTRUCTORS
 ---help---
   Enable constructors.
   
config GCC_PLUGINS
 tristate "Enable gcc plugins"
 select CONFIG_GCC_PLUGINS
 ---help---
   Enable gcc plugins.
```
